## image.its
```
/dts-v1/;

/ {
	description = "Single CinnamOS kernel image";
	#address-cells = <1>;

	images {
		kernel@1 {
			description = "CinnamOS kernel";
			data = /incbin/("./cinnamos.bin.gz");
			type = "kernel";
			arch = "riscv";
			os = "linux";
			compression = "gzip";
			load = <0x80200000>;
			entry = <0x80200000>;
			hash@1 {
				algo = "crc32";
			};
			hash@2 {
				algo = "sha1";
			};
		};
	};

	configurations {
		default = "config@1";
		config@1 {
			description = "Boot CinnamOS kernel";
			kernel = "kernel@1";
		};
	};
};
```
